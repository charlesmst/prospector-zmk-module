## Kconfig
```kconfig
choice PROSPECTOR_STATUS_SCREEN_LAYOUT
    prompt "Status screen layout"
    default PROSPECTOR_STATUS_SCREEN_CLASSIC

config PROSPECTOR_STATUS_SCREEN_CLASSIC
    bool "Classic layout"
    help
        Standard Prospector status screen

config PROSPECTOR_STATUS_SCREEN_RADII
    bool "Radii layout"
    help
        Colorful grid layout with rounded widgets

config PROSPECTOR_STATUS_SCREEN_FIELD
    bool "Field layout"
    help
        Minimal layout with flowing typing activity visualization

config PROSPECTOR_STATUS_SCREEN_OPERATOR
    bool "Operator layout"
    help
        Technical and information dense layout

config PROSPECTOR_STATUS_SCREEN_NONE
    bool "None - application provides its own"
    help
        Build no status screen at all. The application is then responsible for
        defining zmk_display_status_screen(); the panel, backlight, display
        rotation and bundled fonts are still provided as usual. Pick this when
        you want the Prospector hardware with a screen of your own, instead of
        patching one of the layouts above.

endchoice

config PROSPECTOR_ROTATE_DISPLAY_180
    bool "Rotate the display 180 degrees"
    default n

config PROSPECTOR_SHOW_MODIFIERS
    bool "Display modifier key indicators (Cmd, Opt, Ctrl, Shift)"
    default y

config PROSPECTOR_SHOW_INACTIVE_MODIFIERS
    bool "Show inactive modifier indicators (dim when not pressed)"
    default y
    depends on PROSPECTOR_SHOW_MODIFIERS
    help
      When enabled, inactive modifiers are shown with a dim color.
      When disabled, inactive modifiers are hidden completely.
      Only affects classic and field layouts.

config PROSPECTOR_MODIFIER_ORDER
    string "Modifier display order"
    default "GACS"
    depends on PROSPECTOR_SHOW_MODIFIERS
    help
      Order of modifier indicators. Use exactly 4 characters:
      G=GUI/Cmd, A=Alt/Opt, C=Control, S=Shift.
      Each character must appear exactly once.

choice PROSPECTOR_MODIFIER_OS
    prompt "Modifier key style"
    default PROSPECTOR_MODIFIER_OS_MAC
    depends on PROSPECTOR_SHOW_MODIFIERS

config PROSPECTOR_MODIFIER_OS_GENERIC
    bool "Generic (CTRL, ALT, GUI, SHFT)"

config PROSPECTOR_MODIFIER_OS_WINDOWS
    bool "Windows"

config PROSPECTOR_MODIFIER_OS_MAC
    bool "Mac"

endchoice

config PROSPECTOR_USE_AMBIENT_LIGHT_SENSOR
    bool "Use ambient light sensor for auto brightness"
    default y

config PROSPECTOR_FIXED_BRIGHTNESS
    int "Fixed display brightness"
    default 50
    range 1 100
    help
      Used when the ambient light sensor is disabled, and as the fallback when
      it is enabled but not actually fitted -- the sensor is the optional part
      of the BOM, so a board without one is a supported configuration. No
      longer depends on the sensor being off, so enabling auto brightness
      before the hardware is in place degrades cleanly instead of driving the
      backlight from a reading that never arrives.

if PROSPECTOR_USE_AMBIENT_LIGHT_SENSOR

config PROSPECTOR_AMBIENT_LUX_FULL
    int "Ambient reading mapped to full brightness"
    default 400
    help
      Readings at or above this drive the backlight to its ceiling; the curve
      is linear from zero up to here. Was hard-coded at 100, which is dimmer
      than an ordinary lit room -- so the backlight clamped to maximum unless
      the room was nearly dark, which defeats the point. Several hundred suits
      a desk; lower it if the display is brighter than you want indoors.

config PROSPECTOR_BRIGHTNESS_MIN
    int "Backlight floor in darkness"
    default 5
    range 1 100
    help
      Where the backlight lands with no ambient light at all. 1 is nearly
      invisible; raise it if the screen disappears in a dark room.

config PROSPECTOR_BRIGHTNESS_MAX
    int "Backlight ceiling in bright light"
    default 100
    range 1 100

endif # PROSPECTOR_USE_AMBIENT_LIGHT_SENSOR

config PROSPECTOR_LAYER_NAME_UPPERCASE
    bool "Display layer names in uppercase"
    default y
    help
      When enabled, layer names will be converted to uppercase for display.
```
